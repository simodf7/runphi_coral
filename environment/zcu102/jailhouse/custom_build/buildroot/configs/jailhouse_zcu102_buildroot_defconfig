## environment/zcu102/jailhouse/custom_build/buildroot/configs/jailhouse_zcu102_buildroot_defconfig
```kconfig
BR2_aarch64=y
BR2_KERNEL_HEADERS_6_1=y
BR2_PACKAGE_GLIBC_UTILS=y
BR2_TOOLCHAIN_BUILDROOT_CXX=y
BR2_TARGET_GENERIC_ROOT_PASSWD="root"
BR2_SYSTEM_DHCP="eth0"
BR2_SYSTEM_DEFAULT_PATH="/bin:/sbin:/usr/bin:/usr/sbin:/usr/local/bin:/usr/local/sbin:/root/jailhouse/tools"
BR2_ROOTFS_OVERLAY="/home/environment/zcu102/jailhouse/install"
BR2_PACKAGE_RT_TESTS=y
BR2_PACKAGE_STRESS_NG=y
BR2_PACKAGE_JQ=y
BR2_PACKAGE_LIBTOOL=y
BR2_PACKAGE_MAKE=y
BR2_PACKAGE_DROPBEAR=y
# BR2_PACKAGE_DROPBEAR_SMALL is not set
BR2_PACKAGE_ETHTOOL=y
BR2_PACKAGE_HOST_E2FSPROGS=y
BR2_PACKAGE_HOST_KMOD=y
```
